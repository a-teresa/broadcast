/*
 * Copyright (c) 2020 Nordic Semiconductor ASA
 *
 * SPDX-License-Identifier: Apache-2.0
 */

/dts-v1/;
#include <nordic/nrf5340_cpuapp_qkaa.dtsi>
#include "aurascope_nrf5340_cpuapp_common.dtsi"

/ {
	model = "Aurascope NRF5340 Application";
	compatible = "aurascope,aurascope-nrf5340-cpuapp";

	chosen {
		zephyr,sram = &sram0_image;
		zephyr,flash = &flash0;
		zephyr,code-partition = &slot0_partition;
		zephyr,sram-secure-partition = &sram0_s;
		zephyr,sram-non-secure-partition = &sram0_ns;
	};
};

/* Include default memory partition configuration file */
#include <nordic/nrf5340_cpuapp_partition.dtsi>
