## broadcast/build_broadcast_source_i2s/mcuboot/Kconfig/soc/Kconfig.sysbuild
```kconfig
# Load Sysbuild SoC Kconfig descriptions.
osource "/home/t/asset-tracker-template/zephyr/soc/xlnx/zynqmp/Kconfig.sysbuild"
osource "/home/t/asset-tracker-template/zephyr/soc/xlnx/zynq7000/Kconfig.sysbuild"
osource "/home/t/asset-tracker-template/zephyr/soc/xlnx/versalnet/Kconfig.sysbuild"
osource "/home/t/asset-tracker-template/zephyr/soc/xlnx/versal2/Kconfig.sysbuild"
osource "/home/t/asset-tracker-template/zephyr/soc/xlnx/versal/Kconfig.sysbuild"
osource "/home/t/asset-tracker-template/zephyr/soc/xen/Kconfig.sysbuild"
osource "/home/t/asset-tracker-template/zephyr/soc/wch/ch32v/Kconfig.sysbuild"
osource "/home/t/asset-tracker-template/zephyr/soc/ti/simplelink/Kconfig.sysbuild"
osource "/home/t/asset-tracker-template/zephyr/soc/ti/mspm0/Kconfig.sysbuild"
osource "/home/t/asset-tracker-template/zephyr/soc/ti/lm3s6965/Kconfig.sysbuild"
osource "/home/t/asset-tracker-template/zephyr/soc/ti/k3/Kconfig.sysbuild"
osource "/home/t/asset-tracker-template/zephyr/soc/telink/tlsr/Kconfig.sysbuild"
osource "/home/t/asset-tracker-template/zephyr/soc/starfive/jh71xx/Kconfig.sysbuild"
osource "/home/t/asset-tracker-template/zephyr/soc/st/stm32/Kconfig.sysbuild"
osource "/home/t/asset-tracker-template/zephyr/soc/snps/qemu_arc/Kconfig.sysbuild"
osource "/home/t/asset-tracker-template/zephyr/soc/snps/nsim/arc_v/Kconfig.sysbuild"
osource "/home/t/asset-tracker-template/zephyr/soc/snps/nsim/arc_classic/Kconfig.sysbuild"
osource "/home/t/asset-tracker-template/zephyr/soc/snps/hsdk4xd/Kconfig.sysbuild"
osource "/home/t/asset-tracker-template/zephyr/soc/snps/hsdk/Kconfig.sysbuild"
osource "/home/t/asset-tracker-template/zephyr/soc/snps/emsk/Kconfig.sysbuild"
osource "/home/t/asset-tracker-template/zephyr/soc/snps/emsdp/Kconfig.sysbuild"
osource "/home/t/asset-tracker-template/zephyr/soc/snps/arc_iot/Kconfig.sysbuild"
osource "/home/t/asset-tracker-template/zephyr/soc/silabs/Kconfig.sysbuild"
osource "/home/t/asset-tracker-template/zephyr/soc/sifli/sf32/Kconfig.sysbuild"
osource "/home/t/asset-tracker-template/zephyr/soc/sifive/sifive_freedom/Kconfig.sysbuild"
osource "/home/t/asset-tracker-template/zephyr/soc/sensry/Kconfig.sysbuild"
osource "/home/t/asset-tracker-template/zephyr/soc/rockchip/Kconfig.sysbuild"
osource "/home/t/asset-tracker-template/zephyr/soc/renode/riscv_virtual/Kconfig.sysbuild"
osource "/home/t/asset-tracker-template/zephyr/soc/renode/cortex_r8_virtual/Kconfig.sysbuild"
osource "/home/t/asset-tracker-template/zephyr/soc/renesas/smartbond/Kconfig.sysbuild"
osource "/home/t/asset-tracker-template/zephyr/soc/renesas/rz/Kconfig.sysbuild"
osource "/home/t/asset-tracker-template/zephyr/soc/renesas/rx/Kconfig.sysbuild"
osource "/home/t/asset-tracker-template/zephyr/soc/renesas/rcar/Kconfig.sysbuild"
osource "/home/t/asset-tracker-template/zephyr/soc/renesas/ra/Kconfig.sysbuild"
osource "/home/t/asset-tracker-template/zephyr/soc/realtek/ec/Kconfig.sysbuild"
osource "/home/t/asset-tracker-template/zephyr/soc/realtek/ameba/Kconfig.sysbuild"
osource "/home/t/asset-tracker-template/zephyr/soc/raspberrypi/rpi_pico/Kconfig.sysbuild"
osource "/home/t/asset-tracker-template/zephyr/soc/quicklogic/eos_s3/Kconfig.sysbuild"
osource "/home/t/asset-tracker-template/zephyr/soc/qemu/virt_riscv/Kconfig.sysbuild"
osource "/home/t/asset-tracker-template/zephyr/soc/qemu/malta/Kconfig.sysbuild"
osource "/home/t/asset-tracker-template/zephyr/soc/openisa/rv32m1/Kconfig.sysbuild"
osource "/home/t/asset-tracker-template/zephyr/soc/openhwgroup/cva6/Kconfig.sysbuild"
osource "/home/t/asset-tracker-template/zephyr/soc/oct/osd32mp15x/Kconfig.sysbuild"
osource "/home/t/asset-tracker-template/zephyr/soc/nxp/s32/Kconfig.sysbuild"
osource "/home/t/asset-tracker-template/zephyr/soc/nxp/rw/Kconfig.sysbuild"
osource "/home/t/asset-tracker-template/zephyr/soc/nxp/mcx/Kconfig.sysbuild"
osource "/home/t/asset-tracker-template/zephyr/soc/nxp/lpc/Kconfig.sysbuild"
osource "/home/t/asset-tracker-template/zephyr/soc/nxp/layerscape/Kconfig.sysbuild"
osource "/home/t/asset-tracker-template/zephyr/soc/nxp/kinetis/Kconfig.sysbuild"
osource "/home/t/asset-tracker-template/zephyr/soc/nxp/imxrt/Kconfig.sysbuild"
osource "/home/t/asset-tracker-template/zephyr/soc/nxp/imx/Kconfig.sysbuild"
osource "/home/t/asset-tracker-template/zephyr/soc/nuvoton/numicro/Kconfig.sysbuild"
osource "/home/t/asset-tracker-template/zephyr/soc/nuvoton/numaker/Kconfig.sysbuild"
osource "/home/t/asset-tracker-template/zephyr/soc/nuvoton/npcx/Kconfig.sysbuild"
osource "/home/t/asset-tracker-template/zephyr/soc/nuvoton/npcm/Kconfig.sysbuild"
osource "/home/t/asset-tracker-template/zephyr/soc/nordic/Kconfig.sysbuild"
osource "/home/t/asset-tracker-template/zephyr/soc/neorv32/Kconfig.sysbuild"
osource "/home/t/asset-tracker-template/zephyr/soc/native/inf_clock/Kconfig.sysbuild"
osource "/home/t/asset-tracker-template/zephyr/soc/microchip/sam/sama7/Kconfig.sysbuild"
osource "/home/t/asset-tracker-template/zephyr/soc/microchip/sam/sam_d5x_e5x/Kconfig.sysbuild"
osource "/home/t/asset-tracker-template/zephyr/soc/microchip/pic64/Kconfig.sysbuild"
osource "/home/t/asset-tracker-template/zephyr/soc/microchip/pic32c/pic32cz_ca/Kconfig.sysbuild"
osource "/home/t/asset-tracker-template/zephyr/soc/microchip/pic32c/pic32cx_sg/Kconfig.sysbuild"
osource "/home/t/asset-tracker-template/zephyr/soc/microchip/pic32c/pic32cm_jh/Kconfig.sysbuild"
osource "/home/t/asset-tracker-template/zephyr/soc/microchip/miv/Kconfig.sysbuild"
osource "/home/t/asset-tracker-template/zephyr/soc/microchip/mec/Kconfig.sysbuild"
osource "/home/t/asset-tracker-template/zephyr/soc/mediatek/mt8xxx/Kconfig.sysbuild"
osource "/home/t/asset-tracker-template/zephyr/soc/lowrisc/opentitan/Kconfig.sysbuild"
osource "/home/t/asset-tracker-template/zephyr/soc/litex/litex_vexriscv/Kconfig.sysbuild"
osource "/home/t/asset-tracker-template/zephyr/soc/ite/ec/Kconfig.sysbuild"
osource "/home/t/asset-tracker-template/zephyr/soc/intel/wildcat_lake/Kconfig.sysbuild"
osource "/home/t/asset-tracker-template/zephyr/soc/intel/raptor_lake/Kconfig.sysbuild"
osource "/home/t/asset-tracker-template/zephyr/soc/intel/panther_lake/Kconfig.sysbuild"
osource "/home/t/asset-tracker-template/zephyr/soc/intel/lakemont/Kconfig.sysbuild"
osource "/home/t/asset-tracker-template/zephyr/soc/intel/intel_socfpga_std/Kconfig.sysbuild"
osource "/home/t/asset-tracker-template/zephyr/soc/intel/intel_socfpga/Kconfig.sysbuild"
osource "/home/t/asset-tracker-template/zephyr/soc/intel/intel_niosv/Kconfig.sysbuild"
osource "/home/t/asset-tracker-template/zephyr/soc/intel/intel_ish/Kconfig.sysbuild"
osource "/home/t/asset-tracker-template/zephyr/soc/intel/intel_adsp/Kconfig.sysbuild"
osource "/home/t/asset-tracker-template/zephyr/soc/intel/elkhart_lake/Kconfig.sysbuild"
osource "/home/t/asset-tracker-template/zephyr/soc/intel/atom/Kconfig.sysbuild"
osource "/home/t/asset-tracker-template/zephyr/soc/intel/apollo_lake/Kconfig.sysbuild"
osource "/home/t/asset-tracker-template/zephyr/soc/intel/alder_lake/Kconfig.sysbuild"
osource "/home/t/asset-tracker-template/zephyr/soc/infineon/psoc4/Kconfig.sysbuild"
osource "/home/t/asset-tracker-template/zephyr/soc/infineon/edge/Kconfig.sysbuild"
osource "/home/t/asset-tracker-template/zephyr/soc/infineon/cat3/Kconfig.sysbuild"
osource "/home/t/asset-tracker-template/zephyr/soc/infineon/cat1c/Kconfig.sysbuild"
osource "/home/t/asset-tracker-template/zephyr/soc/infineon/cat1b/Kconfig.sysbuild"
osource "/home/t/asset-tracker-template/zephyr/soc/infineon/cat1a/Kconfig.sysbuild"
osource "/home/t/asset-tracker-template/zephyr/soc/gd/gd32/Kconfig.sysbuild"
osource "/home/t/asset-tracker-template/zephyr/soc/gaisler/leon3/Kconfig.sysbuild"
osource "/home/t/asset-tracker-template/zephyr/soc/gaisler/gr716a/Kconfig.sysbuild"
osource "/home/t/asset-tracker-template/zephyr/soc/focaltech/Kconfig.sysbuild"
osource "/home/t/asset-tracker-template/zephyr/soc/espressif/Kconfig.sysbuild"
osource "/home/t/asset-tracker-template/zephyr/soc/ene/kb1200/Kconfig.sysbuild"
osource "/home/t/asset-tracker-template/zephyr/soc/ene/kb106x/Kconfig.sysbuild"
osource "/home/t/asset-tracker-template/zephyr/soc/elan/em32f967/Kconfig.sysbuild"
osource "/home/t/asset-tracker-template/zephyr/soc/egis/Kconfig.sysbuild"
osource "/home/t/asset-tracker-template/zephyr/soc/efinix/sapphire/Kconfig.sysbuild"
osource "/home/t/asset-tracker-template/zephyr/soc/cdns/xtensa_sample_controller/Kconfig.sysbuild"
osource "/home/t/asset-tracker-template/zephyr/soc/cdns/sample_controller32/Kconfig.sysbuild"
osource "/home/t/asset-tracker-template/zephyr/soc/cdns/dc233c/Kconfig.sysbuild"
osource "/home/t/asset-tracker-template/zephyr/soc/brcm/bcmvk/Kconfig.sysbuild"
osource "/home/t/asset-tracker-template/zephyr/soc/brcm/bcm2712/Kconfig.sysbuild"
osource "/home/t/asset-tracker-template/zephyr/soc/brcm/bcm2711/Kconfig.sysbuild"
osource "/home/t/asset-tracker-template/zephyr/soc/blackberry/qnxhv_vm/Kconfig.sysbuild"
osource "/home/t/asset-tracker-template/zephyr/soc/bflb/Kconfig.sysbuild"
osource "/home/t/asset-tracker-template/zephyr/soc/atmel/sam0/Kconfig.sysbuild"
osource "/home/t/asset-tracker-template/zephyr/soc/atmel/sam/Kconfig.sysbuild"
osource "/home/t/asset-tracker-template/zephyr/soc/aspeed/Kconfig.sysbuild"
osource "/home/t/asset-tracker-template/zephyr/soc/arm/Kconfig.sysbuild"
osource "/home/t/asset-tracker-template/zephyr/soc/arm/beetle/Kconfig.sysbuild"
osource "/home/t/asset-tracker-template/zephyr/soc/antmicro/myra/Kconfig.sysbuild"
osource "/home/t/asset-tracker-template/zephyr/soc/andestech/Kconfig.sysbuild"
osource "/home/t/asset-tracker-template/zephyr/soc/amd/acp_6_0/Kconfig.sysbuild"
osource "/home/t/asset-tracker-template/zephyr/soc/ambiq/Kconfig.sysbuild"
osource "/home/t/asset-tracker-template/zephyr/soc/allwinner/sun8i_h3/Kconfig.sysbuild"
osource "/home/t/asset-tracker-template/zephyr/soc/aesc/Kconfig.sysbuild"
osource "/home/t/asset-tracker-template/zephyr/soc/adi/max32/Kconfig.sysbuild"
osource "/home/t/asset-tracker-template/nrf/soc/sercomm/nrf91/Kconfig.sysbuild"
osource "/home/t/asset-tracker-template/nrf/soc/nordic/Kconfig.sysbuild"
```

## broadcast/build_broadcast_source_i2s/nrf5340_audio/Kconfig/boards/Kconfig.sysbuild.tmp
```kconfig
# Load Sysbuild board Kconfig descriptions.
osource "/home/t/asset-tracker-template/nrf/boards/aurascope/aurascope/Kconfig.sysbuild"
```
