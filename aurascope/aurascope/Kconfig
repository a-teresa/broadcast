## aurascope/aurascope/Kconfig
```kconfig
# Aurascope board configuration

# Copyright (c) 2019 Nordic Semiconductor ASA
# SPDX-License-Identifier: Apache-2.0

config BOARD_AURASCOPE
	select BOARD_LATE_INIT_HOOK if BOARD_AURASCOPE_NRF5340_CPUAPP || BOARD_AURASCOPE_NRF5340_CPUAPP_NS
```

## aurascope/aurascope/board.yml
```yaml
board:
  name: aurascope
  full_name: Aurascope
  vendor: nordic
  socs:
  - name: 'nrf5340'
    variants:
    - name: 'ns'
      cpucluster: 'cpuapp'
```

## broadcast/build_broadcast_sink/b0n/Kconfig/soc/Kconfig
```kconfig
# Load Zephyr SoC Kconfig descriptions.
osource "/home/t/asset-tracker-template/zephyr/soc/xlnx/zynqmp/Kconfig"
osource "/home/t/asset-tracker-template/zephyr/soc/xlnx/zynq7000/Kconfig"
osource "/home/t/asset-tracker-template/zephyr/soc/xlnx/versalnet/Kconfig"
osource "/home/t/asset-tracker-template/zephyr/soc/xlnx/versal2/Kconfig"
osource "/home/t/asset-tracker-template/zephyr/soc/xlnx/versal/Kconfig"
osource "/home/t/asset-tracker-template/zephyr/soc/xen/Kconfig"
osource "/home/t/asset-tracker-template/zephyr/soc/wch/ch32v/Kconfig"
osource "/home/t/asset-tracker-template/zephyr/soc/ti/simplelink/Kconfig"
osource "/home/t/asset-tracker-template/zephyr/soc/ti/mspm0/Kconfig"
osource "/home/t/asset-tracker-template/zephyr/soc/ti/lm3s6965/Kconfig"
osource "/home/t/asset-tracker-template/zephyr/soc/ti/k3/Kconfig"
osource "/home/t/asset-tracker-template/zephyr/soc/telink/tlsr/Kconfig"
osource "/home/t/asset-tracker-template/zephyr/soc/starfive/jh71xx/Kconfig"
osource "/home/t/asset-tracker-template/zephyr/soc/st/stm32/Kconfig"
osource "/home/t/asset-tracker-template/zephyr/soc/snps/qemu_arc/Kconfig"
osource "/home/t/asset-tracker-template/zephyr/soc/snps/nsim/arc_v/Kconfig"
osource "/home/t/asset-tracker-template/zephyr/soc/snps/nsim/arc_classic/Kconfig"
osource "/home/t/asset-tracker-template/zephyr/soc/snps/hsdk4xd/Kconfig"
osource "/home/t/asset-tracker-template/zephyr/soc/snps/hsdk/Kconfig"
osource "/home/t/asset-tracker-template/zephyr/soc/snps/emsk/Kconfig"
osource "/home/t/asset-tracker-template/zephyr/soc/snps/emsdp/Kconfig"
osource "/home/t/asset-tracker-template/zephyr/soc/snps/arc_iot/Kconfig"
osource "/home/t/asset-tracker-template/zephyr/soc/silabs/Kconfig"
osource "/home/t/asset-tracker-template/zephyr/soc/sifli/sf32/Kconfig"
osource "/home/t/asset-tracker-template/zephyr/soc/sifive/sifive_freedom/Kconfig"
osource "/home/t/asset-tracker-template/zephyr/soc/sensry/Kconfig"
osource "/home/t/asset-tracker-template/zephyr/soc/rockchip/Kconfig"
osource "/home/t/asset-tracker-template/zephyr/soc/renode/riscv_virtual/Kconfig"
osource "/home/t/asset-tracker-template/zephyr/soc/renode/cortex_r8_virtual/Kconfig"
osource "/home/t/asset-tracker-template/zephyr/soc/renesas/smartbond/Kconfig"
osource "/home/t/asset-tracker-template/zephyr/soc/renesas/rz/Kconfig"
osource "/home/t/asset-tracker-template/zephyr/soc/renesas/rx/Kconfig"
osource "/home/t/asset-tracker-template/zephyr/soc/renesas/rcar/Kconfig"
osource "/home/t/asset-tracker-template/zephyr/soc/renesas/ra/Kconfig"
osource "/home/t/asset-tracker-template/zephyr/soc/realtek/ec/Kconfig"
osource "/home/t/asset-tracker-template/zephyr/soc/realtek/ameba/Kconfig"
osource "/home/t/asset-tracker-template/zephyr/soc/raspberrypi/rpi_pico/Kconfig"
osource "/home/t/asset-tracker-template/zephyr/soc/quicklogic/eos_s3/Kconfig"
osource "/home/t/asset-tracker-template/zephyr/soc/qemu/virt_riscv/Kconfig"
osource "/home/t/asset-tracker-template/zephyr/soc/qemu/malta/Kconfig"
osource "/home/t/asset-tracker-template/zephyr/soc/openisa/rv32m1/Kconfig"
osource "/home/t/asset-tracker-template/zephyr/soc/openhwgroup/cva6/Kconfig"
osource "/home/t/asset-tracker-template/zephyr/soc/oct/osd32mp15x/Kconfig"
osource "/home/t/asset-tracker-template/zephyr/soc/nxp/s32/Kconfig"
osource "/home/t/asset-tracker-template/zephyr/soc/nxp/rw/Kconfig"
osource "/home/t/asset-tracker-template/zephyr/soc/nxp/mcx/Kconfig"
osource "/home/t/asset-tracker-template/zephyr/soc/nxp/lpc/Kconfig"
osource "/home/t/asset-tracker-template/zephyr/soc/nxp/layerscape/Kconfig"
osource "/home/t/asset-tracker-template/zephyr/soc/nxp/kinetis/Kconfig"
osource "/home/t/asset-tracker-template/zephyr/soc/nxp/imxrt/Kconfig"
osource "/home/t/asset-tracker-template/zephyr/soc/nxp/imx/Kconfig"
osource "/home/t/asset-tracker-template/zephyr/soc/nuvoton/numicro/Kconfig"
osource "/home/t/asset-tracker-template/zephyr/soc/nuvoton/numaker/Kconfig"
osource "/home/t/asset-tracker-template/zephyr/soc/nuvoton/npcx/Kconfig"
osource "/home/t/asset-tracker-template/zephyr/soc/nuvoton/npcm/Kconfig"
osource "/home/t/asset-tracker-template/zephyr/soc/nordic/Kconfig"
osource "/home/t/asset-tracker-template/zephyr/soc/neorv32/Kconfig"
osource "/home/t/asset-tracker-template/zephyr/soc/native/inf_clock/Kconfig"
osource "/home/t/asset-tracker-template/zephyr/soc/microchip/sam/sama7/Kconfig"
osource "/home/t/asset-tracker-template/zephyr/soc/microchip/sam/sam_d5x_e5x/Kconfig"
osource "/home/t/asset-tracker-template/zephyr/soc/microchip/pic64/Kconfig"
osource "/home/t/asset-tracker-template/zephyr/soc/microchip/pic32c/pic32cz_ca/Kconfig"
osource "/home/t/asset-tracker-template/zephyr/soc/microchip/pic32c/pic32cx_sg/Kconfig"
osource "/home/t/asset-tracker-template/zephyr/soc/microchip/pic32c/pic32cm_jh/Kconfig"
osource "/home/t/asset-tracker-template/zephyr/soc/microchip/miv/Kconfig"
osource "/home/t/asset-tracker-template/zephyr/soc/microchip/mec/Kconfig"
osource "/home/t/asset-tracker-template/zephyr/soc/mediatek/mt8xxx/Kconfig"
osource "/home/t/asset-tracker-template/zephyr/soc/lowrisc/opentitan/Kconfig"
osource "/home/t/asset-tracker-template/zephyr/soc/litex/litex_vexriscv/Kconfig"
osource "/home/t/asset-tracker-template/zephyr/soc/ite/ec/Kconfig"
osource "/home/t/asset-tracker-template/zephyr/soc/intel/wildcat_lake/Kconfig"
osource "/home/t/asset-tracker-template/zephyr/soc/intel/raptor_lake/Kconfig"
osource "/home/t/asset-tracker-template/zephyr/soc/intel/panther_lake/Kconfig"
osource "/home/t/asset-tracker-template/zephyr/soc/intel/lakemont/Kconfig"
osource "/home/t/asset-tracker-template/zephyr/soc/intel/intel_socfpga_std/Kconfig"
osource "/home/t/asset-tracker-template/zephyr/soc/intel/intel_socfpga/Kconfig"
osource "/home/t/asset-tracker-template/zephyr/soc/intel/intel_niosv/Kconfig"
osource "/home/t/asset-tracker-template/zephyr/soc/intel/intel_ish/Kconfig"
osource "/home/t/asset-tracker-template/zephyr/soc/intel/intel_adsp/Kconfig"
osource "/home/t/asset-tracker-template/zephyr/soc/intel/elkhart_lake/Kconfig"
osource "/home/t/asset-tracker-template/zephyr/soc/intel/atom/Kconfig"
osource "/home/t/asset-tracker-template/zephyr/soc/intel/apollo_lake/Kconfig"
osource "/home/t/asset-tracker-template/zephyr/soc/intel/alder_lake/Kconfig"
osource "/home/t/asset-tracker-template/zephyr/soc/infineon/psoc4/Kconfig"
osource "/home/t/asset-tracker-template/zephyr/soc/infineon/edge/Kconfig"
osource "/home/t/asset-tracker-template/zephyr/soc/infineon/cat3/Kconfig"
osource "/home/t/asset-tracker-template/zephyr/soc/infineon/cat1c/Kconfig"
osource "/home/t/asset-tracker-template/zephyr/soc/infineon/cat1b/Kconfig"
osource "/home/t/asset-tracker-template/zephyr/soc/infineon/cat1a/Kconfig"
osource "/home/t/asset-tracker-template/zephyr/soc/gd/gd32/Kconfig"
osource "/home/t/asset-tracker-template/zephyr/soc/gaisler/leon3/Kconfig"
osource "/home/t/asset-tracker-template/zephyr/soc/gaisler/gr716a/Kconfig"
osource "/home/t/asset-tracker-template/zephyr/soc/focaltech/Kconfig"
osource "/home/t/asset-tracker-template/zephyr/soc/espressif/Kconfig"
osource "/home/t/asset-tracker-template/zephyr/soc/ene/kb1200/Kconfig"
osource "/home/t/asset-tracker-template/zephyr/soc/ene/kb106x/Kconfig"
osource "/home/t/asset-tracker-template/zephyr/soc/elan/em32f967/Kconfig"
osource "/home/t/asset-tracker-template/zephyr/soc/egis/Kconfig"
osource "/home/t/asset-tracker-template/zephyr/soc/efinix/sapphire/Kconfig"
osource "/home/t/asset-tracker-template/zephyr/soc/cdns/xtensa_sample_controller/Kconfig"
osource "/home/t/asset-tracker-template/zephyr/soc/cdns/sample_controller32/Kconfig"
osource "/home/t/asset-tracker-template/zephyr/soc/cdns/dc233c/Kconfig"
osource "/home/t/asset-tracker-template/zephyr/soc/brcm/bcmvk/Kconfig"
osource "/home/t/asset-tracker-template/zephyr/soc/brcm/bcm2712/Kconfig"
osource "/home/t/asset-tracker-template/zephyr/soc/brcm/bcm2711/Kconfig"
osource "/home/t/asset-tracker-template/zephyr/soc/blackberry/qnxhv_vm/Kconfig"
osource "/home/t/asset-tracker-template/zephyr/soc/bflb/Kconfig"
osource "/home/t/asset-tracker-template/zephyr/soc/atmel/sam0/Kconfig"
osource "/home/t/asset-tracker-template/zephyr/soc/atmel/sam/Kconfig"
osource "/home/t/asset-tracker-template/zephyr/soc/aspeed/Kconfig"
osource "/home/t/asset-tracker-template/zephyr/soc/arm/Kconfig"
osource "/home/t/asset-tracker-template/zephyr/soc/arm/beetle/Kconfig"
osource "/home/t/asset-tracker-template/zephyr/soc/antmicro/myra/Kconfig"
osource "/home/t/asset-tracker-template/zephyr/soc/andestech/Kconfig"
osource "/home/t/asset-tracker-template/zephyr/soc/amd/acp_6_0/Kconfig"
osource "/home/t/asset-tracker-template/zephyr/soc/ambiq/Kconfig"
osource "/home/t/asset-tracker-template/zephyr/soc/allwinner/sun8i_h3/Kconfig"
osource "/home/t/asset-tracker-template/zephyr/soc/aesc/Kconfig"
osource "/home/t/asset-tracker-template/zephyr/soc/adi/max32/Kconfig"
osource "/home/t/asset-tracker-template/nrf/soc/sercomm/nrf91/Kconfig"
osource "/home/t/asset-tracker-template/nrf/soc/nordic/Kconfig"
```

## broadcast/build_broadcast_source/Kconfig/arch/Kconfig
```kconfig
# Load Zephyr Arch Kconfig descriptions.
osource "/home/t/asset-tracker-template/zephyr/arch/rx/Kconfig"
osource "/home/t/asset-tracker-template/zephyr/arch/x86/Kconfig"
osource "/home/t/asset-tracker-template/zephyr/arch/xtensa/Kconfig"
osource "/home/t/asset-tracker-template/zephyr/arch/sparc/Kconfig"
osource "/home/t/asset-tracker-template/zephyr/arch/riscv/Kconfig"
osource "/home/t/asset-tracker-template/zephyr/arch/posix/Kconfig"
osource "/home/t/asset-tracker-template/zephyr/arch/mips/Kconfig"
osource "/home/t/asset-tracker-template/zephyr/arch/arm64/Kconfig"
osource "/home/t/asset-tracker-template/zephyr/arch/arm/Kconfig"
osource "/home/t/asset-tracker-template/zephyr/arch/arc/Kconfig"
```

## broadcast/build_broadcast_source/nrf5340_audio/Kconfig/boards/Kconfig.aurascope
```kconfig
# Load board Kconfig descriptions.
osource "/home/t/asset-tracker-template/nrf/boards/aurascope/aurascope/Kconfig.aurascope"
```

## broadcast/build_broadcast_source_i2s/ipc_radio/Kconfig/boards/Kconfig.defconfig
```kconfig
# Load Zephyr board defconfig descriptions.
osource "/home/t/asset-tracker-template/nrf/boards/aurascope/aurascope/Kconfig.defconfig"
```
